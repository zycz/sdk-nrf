## applications/nrf_desktop/Kconfig.sysbuild
```kconfig
#
# Copyright (c) 2024 Nordic Semiconductor ASA
#
# SPDX-License-Identifier: LicenseRef-Nordic-5-Clause
#

config NRF_DEFAULT_BLUETOOTH
	default y if BOARD_NRF54H20DK

source "${ZEPHYR_BASE}/share/sysbuild/Kconfig"
```
