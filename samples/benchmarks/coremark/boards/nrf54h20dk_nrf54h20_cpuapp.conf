## samples/benchmarks/coremark/boards/nrf54h20dk_nrf54h20_cpuapp.conf
```kconfig
#
# Copyright (c) 2024 Nordic Semiconductor ASA
#
# SPDX-License-Identifier: LicenseRef-Nordic-5-Clause

CONFIG_COREMARK_ITERATIONS=10000

CONFIG_LOG_MODE_MINIMAL=y

# Kconfigs required for the STM standalone logging, imported from the nordic-log-stm snippet.
# CONFIG_TEST_LOGGING_DEFAULTS=n
# CONFIG_LOG_FRONTEND=y
# CONFIG_LOG_FRONTEND_ONLY=y
# CONFIG_LOG_FRONTEND_STMESP=y
# CONFIG_LOG_FRONTEND_STMESP_FSC=y

# CONFIG_UART_ASYNC_API=y

CONFIG_PM=y
CONFIG_PM_S2RAM=y
CONFIG_POWEROFF=y
CONFIG_PM_S2RAM_CUSTOM_MARKING=y
CONFIG_CONSOLE=n
CONFIG_UART_CONSOLE=n
CONFIG_SERIAL=n
# CONFIG_GPIO=n
CONFIG_BOOT_BANNER=n
CONFIG_SOC_NRF54H20_CPURAD_ENABLE=y
```

## samples/caf_sensor_manager/remote/Kconfig
```kconfig
#
# Copyright (c) 2022 Nordic Semiconductor ASA
#
# SPDX-License-Identifier: LicenseRef-Nordic-5-Clause
#

#
# Copyright (c) 2024 Nordic Semiconductor ASA
#
# SPDX-License-Identifier: LicenseRef-Nordic-5-Clause
#

config APP_PROVIDE_PM_HOOKS
	bool "Application provides PM hooks"
	default y
	select HAS_PM
	select HAS_POWEROFF

menu "Sensor manager sample (remote core)"
rsource "../src/modules/Kconfig"
endmenu

menu "Zephyr Kernel"
source "Kconfig.zephyr"
endmenu
```

## samples/ipc/ipc_service/boards/nrf54h20dk_nrf54h20_cpuapp.conf
```kconfig
# Copyright (c) 2024 Nordic Semiconductor ASA
# SPDX-License-Identifier: LicenseRef-Nordic-5-Clause

CONFIG_APP_IPC_SERVICE_SEND_INTERVAL=5000
CONFIG_APP_IPC_SERVICE_MESSAGE_LEN=128

CONFIG_PM=y
CONFIG_PM_DEVICE=y
CONFIG_PM_DEVICE_RUNTIME=y
CONFIG_PM_S2RAM=y
CONFIG_PM_S2RAM_CUSTOM_MARKING=y
CONFIG_POWEROFF=y
CONFIG_CONSOLE=n
CONFIG_UART_CONSOLE=n
CONFIG_SERIAL=n
CONFIG_LOG=n

CONFIG_PRINTK=n
CONFIG_GPIO=y
CONFIG_BOOT_BANNER=n
```

## samples/ipc/ipc_service/remote/boards/nrf54h20dk_nrf54h20_cpurad.conf
```kconfig
# Copyright (c) 2024 Nordic Semiconductor ASA
# SPDX-License-Identifier: LicenseRef-Nordic-5-Clause

CONFIG_APP_IPC_SERVICE_SEND_INTERVAL=90000000

CONFIG_PM=y
CONFIG_POWEROFF=y
CONFIG_CONSOLE=n
CONFIG_UART_CONSOLE=n
CONFIG_SERIAL=n
CONFIG_GPIO=n
CONFIG_BOOT_BANNER=n

CONFIG_LOG=n
CONFIG_PRINTK=n
```
